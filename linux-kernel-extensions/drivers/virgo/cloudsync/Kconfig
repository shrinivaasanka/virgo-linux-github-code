## linux-kernel-extensions/drivers/virgo/cloudsync/Kconfig
```kconfig
#
# VIRGO Kconfig file
#
config VIRGO_DEBUG
	bool "VIRGO verbose debug messages"
	help
	  Say Y here if you want the VIRGO core & hub drivers to produce a bunch
	  of debug messages to the system log. Select this if you are having a
	  problem with VIRGO support and want to see more of what is going on.
```

## linux-kernel-extensions/drivers/virgo/cpupooling/virgo_cloud_test_kernelspace.notneeded/Kconfig
```kconfig
#
# VIRGO Kconfig file
#
config VIRGO_CLOUD_TEST_KERNELSPACE_DEBUG
	bool "VIRGO clodu test kernel space verbose debug messages"
	help
	  Say Y here if you want the VIRGO cloud  test drivers to produce a bunch
	  of debug messages to the system log. Select this if you are having a
	  problem with VIRGO support and want to see more of what is going on.
```
